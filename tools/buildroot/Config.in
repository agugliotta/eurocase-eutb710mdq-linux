## tools/buildroot/configs/tablet_sd_defconfig
```kconfig
BR2_arm=y
BR2_cortex_a7=y
BR2_ARM_FPU_NEON_VFPV4=y
BR2_TOOLCHAIN_EXTERNAL=y
BR2_TOOLCHAIN_EXTERNAL_BOOTLIN=y
BR2_TOOLCHAIN_EXTERNAL_BOOTLIN_ARMV7_EABIHF_MUSL_STABLE=y
BR2_REPRODUCIBLE=y
BR2_PRIMARY_SITE="https://sources.buildroot.net"
BR2_WGET="wget --passive-ftp -nd -t 3 --timeout=30"
BR2_TARGET_GENERIC_HOSTNAME="tablet"
BR2_TARGET_GENERIC_ISSUE="Eurocase SD POC"
# BR2_TARGET_GENERIC_REMOUNT_ROOTFS_RW is not set
# BR2_TARGET_GENERIC_GETTY is not set
# BR2_TARGET_ENABLE_ROOT_LOGIN is not set
BR2_ROOTFS_DEVICE_CREATION_DYNAMIC_DEVTMPFS=y
BR2_ROOTFS_OVERLAY="$(BR2_EXTERNAL_TABLET_PATH)/board/rootfs-overlay"
BR2_ROOTFS_POST_BUILD_SCRIPT="$(BR2_EXTERNAL_TABLET_PATH)/board/post-build.sh"
BR2_ROOTFS_POST_IMAGE_SCRIPT="$(BR2_EXTERNAL_TABLET_PATH)/board/post-image.sh"
BR2_PACKAGE_TABLET_POC=y
BR2_PACKAGE_ALSA_LIB=y
BR2_PACKAGE_ALSA_LIB_PCM_PLUGINS="hw"
BR2_PACKAGE_ALSA_LIB_CTL_PLUGINS="hw"
# BR2_PACKAGE_ALSA_LIB_ALOAD is not set
# BR2_PACKAGE_ALSA_LIB_MIXER is not set
# BR2_PACKAGE_ALSA_LIB_RAWMIDI is not set
# BR2_PACKAGE_ALSA_LIB_HWDEP is not set
# BR2_PACKAGE_ALSA_LIB_SEQ is not set
# BR2_PACKAGE_ALSA_LIB_UCM is not set
# BR2_PACKAGE_ALSA_LIB_ALISP is not set
# BR2_PACKAGE_ALSA_LIB_TOPOLOGY is not set
# BR2_TARGET_ROOTFS_TAR is not set
BR2_TARGET_ROOTFS_SQUASHFS=y
BR2_TARGET_ROOTFS_SQUASHFS4_GZIP=y
BR2_PACKAGE_HOST_GENIMAGE=y
BR2_PACKAGE_HOST_DOSFSTOOLS=y
BR2_PACKAGE_HOST_MTOOLS=y

BR2_PACKAGE_IW=y
BR2_PACKAGE_WPA_SUPPLICANT=y
BR2_PACKAGE_WPA_SUPPLICANT_NL80211=y
BR2_PACKAGE_WPA_SUPPLICANT_CLI=y
BR2_PACKAGE_WPA_SUPPLICANT_PASSPHRASE=y
# BR2_PACKAGE_WPA_SUPPLICANT_WPA3 is not set
# BR2_PACKAGE_WPA_SUPPLICANT_WPS is not set
# BR2_PACKAGE_WPA_SUPPLICANT_EAP is not set
# BR2_PACKAGE_WPA_SUPPLICANT_WEXT is not set
```

## tools/buildroot/package/tablet-poc/Config.in
```kconfig
config BR2_PACKAGE_TABLET_POC
    bool "tablet-poc"
    depends on BR2_TOOLCHAIN_HAS_THREADS
    select BR2_PACKAGE_ALSA_LIB
    help
      Existing console touchscreen POC; no graphics migration.
```
